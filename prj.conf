## CMakeLists.txt
```
#
# Copyright (c) 2018 Nordic Semiconductor
#
# SPDX-License-Identifier: LicenseRef-Nordic-5-Clause
#
cmake_minimum_required(VERSION 3.20.0)

set(PM_STATIC_YML_FILE
  ${CMAKE_CURRENT_SOURCE_DIR}/boards/pm_static_${BOARD}.yml
  )

find_package(Zephyr REQUIRED HINTS $ENV{ZEPHYR_BASE})
project(ZAP)

# NORDIC SDK APP START
target_sources(app PRIVATE
  src/main.c
  src/svc.c
)

# Preinitialization related to Thingy:53 DFU
target_sources_ifdef(CONFIG_BOARD_THINGY53_NRF5340_CPUAPP app PRIVATE
  boards/thingy53.c
)
target_sources_ifdef(CONFIG_BOARD_THINGY53_NRF5340_CPUAPP_NS app PRIVATE
  boards/thingy53.c
)


# NORDIC SDK APP END
zephyr_library_include_directories(src)
```

## Kconfig
```
source "Kconfig.zephyr"

menu "Nordic LED-Button BLE GATT service sample"

config BT_LBS_SECURITY_ENABLED
	bool "Enable security"
	default n
	select BT_SMP
	select BT_SETTINGS
	select FLASH
	select FLASH_PAGE_LAYOUT
	select FLASH_MAP
	select NVS
	select SETTINGS
	help
	  "Enable BLE security for the LED-Button service"

endmenu
```

## prj.conf
```kconfig
#
# Copyright (c) 2018 Nordic Semiconductor
#
# SPDX-License-Identifier: LicenseRef-Nordic-5-Clause
#
CONFIG_NCS_SAMPLES_DEFAULTS=y

CONFIG_BT=y
CONFIG_BT_PERIPHERAL=y
CONFIG_BT_DEVICE_NAME="PROJEKT_ZAP"

# Enable the LBS service
CONFIG_BT_LBS=y
CONFIG_BT_LBS_POLL_BUTTON=y
CONFIG_DK_LIBRARY=y

CONFIG_LOG=y

CONFIG_PWM=y

CONFIG_LED=y
CONFIG_LED_PWM=y


CONFIG_SYSTEM_WORKQUEUE_STACK_SIZE=2048
```

## src/main.c
```c
#include <drivers/gpio.h>
#include <errno.h>
#include <soc.h>
#include <stddef.h>
#include <string.h>
#include <sys/byteorder.h>
#include <sys/printk.h>
#include <zephyr.h>
#include <zephyr/types.h>


#include <bluetooth/bluetooth.h>
#include <bluetooth/conn.h>
#include <bluetooth/gatt.h>
#include <bluetooth/hci.h>
#include <bluetooth/uuid.h>


#include "svc.h"

#include <settings/settings.h>

#include <dk_buttons_and_leds.h>

#include <device.h>
#include <drivers/led.h>
#include <sys/util.h>

#if DT_NODE_HAS_STATUS(DT_INST(0, pwm_leds), okay)
#define LED_PWM_NODE_ID DT_INST(0, pwm_leds)
#define LED_PWM_DEV_NAME DEVICE_DT_NAME(LED_PWM_NODE_ID)
#else
#error "No LED PWM device found";
#endif

#define LED_PWM_LABEL(led_node_id) DT_PROP_OR(led_node_id, label, NULL),

const char *led_label[] = {DT_FOREACH_CHILD(LED_PWM_NODE_ID, LED_PWM_LABEL)};

const int num_leds = ARRAY_SIZE(led_label);

const struct device *led_pwm;

#define MAX_BRIGHTNESS 100
#define FADE_DELAY_MS 10
#define FADE_DELAY K_MSEC(FADE_DELAY_MS)

#define DEVICE_NAME "ZAP_PROJEKT"
#define DEVICE_NAME_LEN (sizeof(DEVICE_NAME) - 1)

#define RUN_LED_BLINK_INTERVAL 500
#define RUN_LED_BLINK_DELAY 500



static void run_led_test(const struct device *led_pwm, uint8_t led) {
  int err;
  uint16_t level;
  /* Increase LED brightness gradually up to the maximum level. */
  for (level = 0; level <= MAX_BRIGHTNESS; level++) {
    err = led_set_brightness(led_pwm, led, level);
    if (err < 0) {
      return;
    }
    k_sleep(FADE_DELAY);
  }
  k_sleep(K_MSEC(1000));
  for (level = MAX_BRIGHTNESS; level >= 0; level--) {
    err = led_set_brightness(led_pwm, led, level);
    if (err < 0) {
      return;
    }
    k_sleep(FADE_DELAY);
  }
  k_sleep(K_MSEC(1000));
  /* Turn LED off. */
  err = led_off(led_pwm, led);
  if (err < 0) {
    return;
  }
}

static void turn_off_leds() {
  for(int i=0; i < num_leds; i++) {
    led_off(led_pwm, i);
  }
}

static int pwm_leds_init() {

  led_pwm = device_get_binding(LED_PWM_DEV_NAME);
  if (led_pwm) {
    printk("Found LED PWM device: %s\n", LED_PWM_DEV_NAME);
  } else {
    printk("Device %s not found", LED_PWM_DEV_NAME);
    return -1;
  }

  if (!num_leds) {
    printk("No LEDs found for %s\n", LED_PWM_DEV_NAME);
    return -1;
  }
  printk("Number of PWM LEDs: %d\n", num_leds);
  return 0;
}

static const struct bt_data ad[] = {
    BT_DATA_BYTES(BT_DATA_FLAGS, (BT_LE_AD_GENERAL | BT_LE_AD_NO_BREDR)),
    BT_DATA(BT_DATA_NAME_COMPLETE, DEVICE_NAME, DEVICE_NAME_LEN),
};

static const struct bt_data sd[] = {
    BT_DATA_BYTES(BT_DATA_UUID128_ALL, BT_UUID_LED_SVC_VAL),
};

static void connected(struct bt_conn *conn, uint8_t err) {
  if (err) {
    printk("Connection failed (err %u)\n", err);
    return;
  }

  printk("Connected\n");

}

static void disconnected(struct bt_conn *conn, uint8_t reason) {
  printk("Disconnected (reason %u)\n", reason);
  turn_off_leds();
}

static struct bt_conn_cb connection_callbacks = {
    .connected = connected,
    .disconnected = disconnected,
};


void set_brightness(uint8_t led_num, uint8_t led_state) {
	if (led_state == 200) {
		for(int i = 0; i < 3; ++i) {
			run_led_test(led_pwm, led_num);
		}
	} else {
		uint8_t brightness = MIN(led_state, MAX_BRIGHTNESS);
		printk("LED %d received PWM value: %d\n", led_num + 1, led_state);
		led_set_brightness(led_pwm, led_num, brightness);
	}
}

static void application_led1_callback(uint8_t led_state) {
	set_brightness(0, led_state);
}

static void application_led2_callback(uint8_t led_state) {
	set_brightness(1, led_state);
}

static void application_led3_callback(uint8_t led_state) {
	set_brightness(2, led_state);
}

static void application_led4_callback(uint8_t led_state) {
	set_brightness(3, led_state);
}

static struct bt_led_svc_cbs led_svc_callbacks = {
    .led1_cb = application_led1_callback,
    .led2_cb = application_led2_callback,
    .led3_cb = application_led3_callback,
    .led4_cb = application_led4_callback,
};

void main(void) {
  int err;

  err = pwm_leds_init();
  if (err) {
    printk("PWM leds init failed (err:%D)\n", err);
    return;
  }

  bt_conn_cb_register(&connection_callbacks);

  err = bt_enable(NULL);
  if (err) {
    printk("Bluetooth init failed (err %d)\n", err);
    return;
  }

  printk("Bluetooth initialized\n");

  err = bt_led_svc_init(&led_svc_callbacks);
  if (err) {
    printk("Failed to init LED service (err:%d)\n", err);
    return;
  }

  err = bt_le_adv_start(BT_LE_ADV_CONN, ad, ARRAY_SIZE(ad), sd, ARRAY_SIZE(sd));
  if (err) {
    printk("Advertising failed to start (err %d)\n", err);
    return;
  }

  printk("Advertising successfully started\n");

  for (;;) {
    k_sleep(K_MSEC(RUN_LED_BLINK_DELAY));
  }
}
```

## src/svc.c
```c
#include <zephyr/types.h>
#include <stddef.h>
#include <string.h>
#include <errno.h>
#include <sys/printk.h>
#include <sys/byteorder.h>
#include <zephyr.h>

#include <bluetooth/bluetooth.h>
#include <bluetooth/hci.h>
#include <bluetooth/conn.h>
#include <bluetooth/uuid.h>
#include <bluetooth/gatt.h>

#include "svc.h"
#include <logging/log.h>


static bool                   notify_enabled;
static struct bt_led_svc_cbs       led_svc_cbs;

static void lbslc_ccc_cfg_changed(const struct bt_gatt_attr *attr,
				  uint16_t value)
{
	notify_enabled = (value == BT_GATT_CCC_NOTIFY);
}

static ssize_t check_input(struct bt_conn *conn, const struct bt_gatt_attr *attr, uint16_t len, uint16_t offset) {
	printk("Attribute write, handle: %u, conn: %p\n", attr->handle,
		(void *)conn);
	if (len != 1U) {
		printk("Write led: Incorrect data length");
		return BT_GATT_ERR(BT_ATT_ERR_INVALID_ATTRIBUTE_LEN);
	}

	if (offset != 0) {
		printk("Write led: Incorrect data offset");
		return BT_GATT_ERR(BT_ATT_ERR_INVALID_OFFSET);
	}
	return 0;
}

static ssize_t run_callback(struct bt_conn *conn,
			 const struct bt_gatt_attr *attr,
			 const void *buf,
			 uint16_t len, uint16_t offset, uint8_t flags,
			 led_cb_t callback) {
	ssize_t err = check_input(conn, attr, len, offset);
	if( err != 0) {
		return err;
	}

	if (callback) {
		uint8_t val = *((uint8_t *)buf);
		callback(val);
	}

	return len;

}

static ssize_t write_led1(struct bt_conn *conn,
			 const struct bt_gatt_attr *attr,
			 const void *buf,
			 uint16_t len, uint16_t offset, uint8_t flags)
{
	return run_callback(conn, attr, buf, len, offset, flags, led_svc_cbs.led1_cb);
}

static ssize_t write_led2(struct bt_conn *conn,
			 const struct bt_gatt_attr *attr,
			 const void *buf,
			 uint16_t len, uint16_t offset, uint8_t flags)
{

	return run_callback(conn, attr, buf, len, offset, flags, led_svc_cbs.led2_cb);
}

static ssize_t write_led3(struct bt_conn *conn,
			 const struct bt_gatt_attr *attr,
			 const void *buf,
			 uint16_t len, uint16_t offset, uint8_t flags)
{

	return run_callback(conn, attr, buf, len, offset, flags, led_svc_cbs.led3_cb);
}

static ssize_t write_led4(struct bt_conn *conn,
			 const struct bt_gatt_attr *attr,
			 const void *buf,
			 uint16_t len, uint16_t offset, uint8_t flags)
{
	return run_callback(conn, attr, buf, len, offset, flags, led_svc_cbs.led4_cb);
}


BT_GATT_SERVICE_DEFINE(our_svc,
BT_GATT_PRIMARY_SERVICE(BT_UUID_LED_SVC),
	BT_GATT_CCC(lbslc_ccc_cfg_changed,
		    BT_GATT_PERM_READ | BT_GATT_PERM_WRITE),
	BT_GATT_CHARACTERISTIC(BT_UUID_LED_SVC_LED1,
			       BT_GATT_CHRC_WRITE,
			       BT_GATT_PERM_WRITE,
			       NULL, write_led1, NULL),
	BT_GATT_CHARACTERISTIC(BT_UUID_LED_SVC_LED2,
				BT_GATT_CHRC_WRITE,
				BT_GATT_PERM_WRITE,
				NULL, write_led2, NULL),
	BT_GATT_CHARACTERISTIC(BT_UUID_LED_SVC_LED3,
				BT_GATT_CHRC_WRITE,
				BT_GATT_PERM_WRITE,
				NULL, write_led3, NULL),
	BT_GATT_CHARACTERISTIC(BT_UUID_LED_SVC_LED4,
				BT_GATT_CHRC_WRITE,
				BT_GATT_PERM_WRITE,
				NULL, write_led4, NULL),
);

int bt_led_svc_init(struct bt_led_svc_cbs *callbacks)
{
	if (callbacks) {
		led_svc_cbs.led1_cb    = callbacks->led1_cb;
		led_svc_cbs.led2_cb    = callbacks->led2_cb;
		led_svc_cbs.led3_cb    = callbacks->led3_cb;
		led_svc_cbs.led4_cb    = callbacks->led4_cb;
	}

	return 0;
}
```

## src/svc.h
```c
#ifndef BT_LED_SVC_H_
#define BT_LED_SVC_H_



#ifdef __cplusplus
extern "C" {
#endif

#include <zephyr/types.h>

#define BT_UUID_LED_SVC_VAL \
	BT_UUID_128_ENCODE(0x00000001, 0x1212, 0xefde, 0x1523, 0x785feabcd123)


#define BT_UUID_LED_SVC_LED1_VAL \
	BT_UUID_128_ENCODE(0x00000002, 0x1212, 0xefde, 0x1523, 0x785feabcd123)

#define BT_UUID_LED_SVC_LED2_VAL \
	BT_UUID_128_ENCODE(0x00000003, 0x1212, 0xefde, 0x1523, 0x785feabcd123)

#define BT_UUID_LED_SVC_LED3_VAL \
	BT_UUID_128_ENCODE(0x00000004, 0x1212, 0xefde, 0x1523, 0x785feabcd123)

#define BT_UUID_LED_SVC_LED4_VAL \
	BT_UUID_128_ENCODE(0x00000005, 0x1212, 0xefde, 0x1523, 0x785feabcd123)


#define BT_UUID_LED_SVC           BT_UUID_DECLARE_128(BT_UUID_LED_SVC_VAL)
#define BT_UUID_LED_SVC_LED1       BT_UUID_DECLARE_128(BT_UUID_LED_SVC_LED1_VAL)
#define BT_UUID_LED_SVC_LED2       BT_UUID_DECLARE_128(BT_UUID_LED_SVC_LED2_VAL)
#define BT_UUID_LED_SVC_LED3       BT_UUID_DECLARE_128(BT_UUID_LED_SVC_LED3_VAL)
#define BT_UUID_LED_SVC_LED4       BT_UUID_DECLARE_128(BT_UUID_LED_SVC_LED4_VAL)


typedef void (*led_cb_t)(const uint8_t led_state);


struct bt_led_svc_cbs {
	/** LED state change callback. */
	led_cb_t    led1_cb;
	led_cb_t    led2_cb;
	led_cb_t    led3_cb;
	led_cb_t    led4_cb;
};

int bt_led_svc_init(struct bt_led_svc_cbs *callbacks);


#ifdef __cplusplus
}
#endif


#endif /* BT_LED_SVC_H_ */
```
