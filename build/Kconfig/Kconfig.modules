## build/Kconfig/Kconfig.modules
```kconfig
menu "nrf (P:\nordicsemi\v1.8.0\nrf)"
osource "P:/nordicsemi/v1.8.0/nrf/Kconfig.nrf"
config ZEPHYR_NRF_MODULE
	bool
	default y
endmenu
menu "mcuboot (P:\nordicsemi\v1.8.0\bootloader\mcuboot)"
osource "$(ZEPHYR_MCUBOOT_KCONFIG)"
config ZEPHYR_MCUBOOT_MODULE
	bool
	default y
endmenu
menu "trusted-firmware-m (P:\nordicsemi\v1.8.0\modules\tee\tfm)"
osource "$(ZEPHYR_TRUSTED_FIRMWARE_M_KCONFIG)"
config ZEPHYR_TRUSTED_FIRMWARE_M_MODULE
	bool
	default y
endmenu
menu "cjson (P:\nordicsemi\v1.8.0\modules\lib\cjson)"
osource "$(ZEPHYR_CJSON_KCONFIG)"
config ZEPHYR_CJSON_MODULE
	bool
	default y
endmenu
menu "pelion-dm (P:\nordicsemi\v1.8.0\modules\lib\pelion-dm)"
osource "P:/nordicsemi/v1.8.0/modules/lib/pelion-dm/zephyr/Kconfig"
config ZEPHYR_PELION_DM_MODULE
	bool
	default y
endmenu
menu "cddl-gen (P:\nordicsemi\v1.8.0\modules\lib\cddl-gen)"
osource "$(ZEPHYR_CDDL_GEN_KCONFIG)"
config ZEPHYR_CDDL_GEN_MODULE
	bool
	default y
endmenu
menu "memfault-firmware-sdk (P:\nordicsemi\v1.8.0\modules\lib\memfault-firmware-sdk)"
osource "P:/nordicsemi/v1.8.0/modules/lib/memfault-firmware-sdk/ports/zephyr/Kconfig"
config ZEPHYR_MEMFAULT_FIRMWARE_SDK_MODULE
	bool
	default y
endmenu
menu "CANopenNode (P:\nordicsemi\v1.8.0\modules\lib\canopennode)"
osource "$(ZEPHYR_CANOPENNODE_KCONFIG)"
config ZEPHYR_CANOPENNODE_MODULE
	bool
	default y
endmenu
menu "hal_nordic (P:\nordicsemi\v1.8.0\modules\hal\nordic)"
osource "$(ZEPHYR_HAL_NORDIC_KCONFIG)"
config ZEPHYR_HAL_NORDIC_MODULE
	bool
	default y
endmenu
menu "loramac-node (P:\nordicsemi\v1.8.0\modules\lib\loramac-node)"
osource "$(ZEPHYR_LORAMAC_NODE_KCONFIG)"
config ZEPHYR_LORAMAC_NODE_MODULE
	bool
	default y
endmenu
menu "lz4 (P:\nordicsemi\v1.8.0\modules\lib\lz4)"
osource "$(ZEPHYR_LZ4_KCONFIG)"
config ZEPHYR_LZ4_MODULE
	bool
	default y
endmenu
menu "mbedtls (P:\nordicsemi\v1.8.0\modules\crypto\mbedtls)"
osource "$(ZEPHYR_MBEDTLS_KCONFIG)"
config ZEPHYR_MBEDTLS_MODULE
	bool
	default y
endmenu
menu "nanopb (P:\nordicsemi\v1.8.0\modules\lib\nanopb)"
osource "$(ZEPHYR_NANOPB_KCONFIG)"
config ZEPHYR_NANOPB_MODULE
	bool
	default y
endmenu
menu "TraceRecorder (P:\nordicsemi\v1.8.0\modules\debug\TraceRecorder)"
osource "P:/nordicsemi/v1.8.0/modules/debug/TraceRecorder/kernelports/Zephyr/Kconfig"
config ZEPHYR_TRACERECORDER_MODULE
	bool
	default y
endmenu
menu "nrfxlib (P:\nordicsemi\v1.8.0\nrfxlib)"
osource "P:/nordicsemi/v1.8.0/nrfxlib/Kconfig.nrfxlib"
config ZEPHYR_NRFXLIB_MODULE
	bool
	default y
endmenu
menu "connectedhomeip (P:\nordicsemi\v1.8.0\modules\lib\matter)"
osource "P:/nordicsemi/v1.8.0/modules/lib/matter/config/nrfconnect/chip-module/Kconfig"
config ZEPHYR_CONNECTEDHOMEIP_MODULE
	bool
	default y
endmenu
```

## build/Kconfig/Kconfig.shield
```kconfig
osource "p:/Sources/C/NRF/lbs/boards/shields/*/Kconfig.shield"
osource "P:/nordicsemi/v1.8.0/nrf/boards/shields/*/Kconfig.shield"
```

## build/Kconfig/Kconfig.shield.defconfig
```kconfig
osource "p:/Sources/C/NRF/lbs/boards/shields/*/Kconfig.defconfig"
osource "P:/nordicsemi/v1.8.0/nrf/boards/shields/*/Kconfig.defconfig"
```
